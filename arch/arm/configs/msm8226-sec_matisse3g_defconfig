## arch/arm/configs/msm8226-sec_matisse3g_defconfig
```kconfig
# SSWAP
CONFIG_SWAP=y
CONFIG_FRONTSWAP=y
CONFIG_ZSMALLOC_NEW=y
CONFIG_PGTABLE_MAPPING=y
CONFIG_ZSWAP=y
CONFIG_DIRECT_RECLAIM_FILE_PAGES_ONLY=n
CONFIG_INCREASE_MAXIMUM_SWAPPINESS=y
CONFIG_FIX_INACTIVE_RATIO=y
CONFIG_TIGHT_PGDAT_BALANCE=y
CONFIG_VNSWAP=y
CONFIG_SWAP_ENABLE_READAHEAD=n

#variant defconfig
CONFIG_MACH_MATISSE3G_OPEN=y
CONFIG_SEC_MATISSE_PROJECT=y

#Power Management
CONFIG_SEC_PM=n

#LCD
CONFIG_FB_MSM_MDSS_TC_DSI2LVDS_WXGA_PANEL=y
CONFIG_FB_MSM8x26_MDSS_CHECK_LCD_CONNECTION=y
CONFIG_FB_MSM_MDSS=y
CONFIG_FB_MSM_MDSS_WRITEBACK=y
CONFIG_BACKLIGHT_LCD_SUPPORT=y
CONFIG_MDNIE_TFT_MSM8X26=y
CONFIG_LCD_CLASS_DEVICE=y
CONFIG_BACKLIGHT_CLASS_DEVICE=y

#VIBRATOR
CONFIG_HAPTIC_ISA1200=y

#SvcLED
CONFIG_LEDS_GPIO=y

#TSP
CONFIG_TOUCHSCREEN_ATMEL_MXT1188S=y

#SENSOR
CONFIG_SENSORS=y
CONFIG_SENSORS_K2HH=y
CONFIG_SENSORS_SX9500=y
CONFIG_SENSORS_SX9500_INIT_TOUCH_THRESHOLD=3000
CONFIG_SENSORS_SX9500_NORMAL_TOUCH_THRESHOLD=15
CONFIG_SENSORS_GRIP_ADJDET=y
CONFIG_INPUT=y
CONFIG_INPUT_GPIO=y
CONFIG_SENSORS_HALL=y


#CAMERA
CONFIG_MSM_CPP=y
CONFIG_SR352=y
CONFIG_SR130PC20=y

#USB
CONFIG_USB_ANDROID_SAMSUNG_COMPOSITE=y
CONFIG_USB_DUN_SUPPORT=y
CONFIG_USB_ANDROID_SAMSUNG_SIDESYNC=y

#USB Host
CONFIG_USB_HOST_NOTIFY=y
CONFIG_USB_STORAGE_DETECT=y
CONFIG_USB_NET_SMSC75XX=y
CONFIG_USB_NET_SMSC95XX=y

#MUIC
CONFIG_SM5502_MUIC=y

#Battery charging & BMS
CONFIG_BATTERY_SAMSUNG=y
CONFIG_CHARGER_SMB358=y
CONFIG_BATTERY_BCL=y
CONFIG_QPNP_BMS=y
CONFIG_SAMSUNG_LPM_MODE=y

#Sec Thermistor
CONFIG_SEC_THERMISTOR=y

# Earjack
CONFIG_SAMSUNG_JACK=y

# TIMA LOG
CONFIG_ARCH_MSM8226_3G_WIFI=y
CONFIG_MUIC_SM5502_SUPPORT_LANHUB_TA=y

CONFIG_SEC_DHA_SOL_MAL=y

# QCOM DEBUG
CONFIG_MSM_RTB=y
CONFIG_MSM_RTB_SEPARATE_CPUS=y 
```
